## config/boards/shields/Test/Kconfig.defconfig
```kconfig
if SHIELD_ROBA_R

config ZMK_KEYBOARD_NAME
    default "cool642tb-mini_R"

config ZMK_SPLIT
    default y

config ZMK_SPLIT_ROLE_CENTRAL
    default y

config ZMK_BOARD_COMPAT
    def_bool y

endif

if SHIELD_ROBA_L

config ZMK_KEYBOARD_NAME
    default "cool642tb-mini_L"

config ZMK_SPLIT
    default y

config ZMK_BOARD_COMPAT
    def_bool y

endif
```

## config/boards/shields/Test/Kconfig.shield
```kconfig
config SHIELD_COOL642TB_MINI
    bool "cool642tb-mini ZMK Shield"
    select ZMK_BOARD_COMPAT
    default $(shields_list_contains,cool642tb-mini)

config SHIELD_ROBA_R
    def_bool $(shields_list_contains,cool642tb-mini_R)

config SHIELD_ROBA_L
    def_bool $(shields_list_contains,cool642tb-mini_L)
```

## config/boards/shields/settings_reset/Kconfig.shield
```kconfig
config ZMK_KEYBOARD_SETTINGS_RESET
    bool "Settings Reset Shield"
    select ZMK_BOARD_COMPAT
    default $(shields_list_contains,cool642tb-mini)
```
